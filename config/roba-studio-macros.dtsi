// Generated by roBa Studio. Text is encoded as keycodes; this is still sensitive data.
#include <dt-bindings/zmk/keys.h>
/ {
    macros {
        rsm_7ef1766a_713b68e2af71: rsm_7ef1766a_713b68e2af71 {
            compatible = "zmk,behavior-macro";
            #binding-cells = <0>;
            display-name = "RS:7ef1766a:713b68e2af71";
            wait-ms = <40>;
            tap-ms = <40>;
            bindings = <&macro_tap>,
                       <&kp N>,
                       <&kp A>,
                       <&kp M>,
                       <&kp E>,
                       <&kp LS(NUMBER_2)>,
                       <&kp E>,
                       <&kp X>,
                       <&kp A>,
                       <&kp M>,
                       <&kp P>,
                       <&kp L>,
                       <&kp E>,
                       <&kp DOT>,
                       <&kp C>,
                       <&kp O>,
                       <&kp M>;
        };
    };
};
