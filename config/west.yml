## config/west.yml
```yaml
manifest:
  remotes:
    - name: zmkfirmware
      url-base: https://github.com/zmkfirmware
    - name: kumamuk-git
      url-base: https://github.com/kumamuk-git
  projects:
    - name: zmk
      remote: zmkfirmware
      revision: acfd8e5ea76cf23ad1c9b6b99848f97a95224257
      import:
        file: app/west.yml
        name-blocklist: [zmk-studio-messages]
    - name: zmk-studio-messages
      url: https://github.com/cormoran/zmk-studio-messages
      revision: 89b81d2e587fce807b668dff2a6967a40beef421
      path: modules/msgs/zmk-studio-messages
    - name: zmk-pmw3610-driver
      remote: kumamuk-git
      revision: 5e04553ab803d24405bd45621a41310ea3050e59
  self:
    path: config
```

## modules/roba-runtime/Kconfig
```kconfig
config ROBA_RUNTIME_MACROS
    bool "roBa Studio transactional text macros"
    default y
    depends on ZMK_STUDIO && SETTINGS
```

## modules/roba-runtime/dts/bindings/behaviors/roba,dynamic-macro.yaml
```yaml
description: Persistent transactional text macro with an ownership token
compatible: "roba,dynamic-macro"
include: two_param.yaml
```
